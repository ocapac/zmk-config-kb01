## config/west.yml
```yaml
manifest:
  remotes:
    - name: zmkfirmware
      url-base: https://github.com/zmkfirmware
    - name: ocapac
      url-base: https://github.com/ocapac
  projects:
    - name: zmk
      remote: zmkfirmware
      revision: v0.3
      import: app/west.yml
    - name: zmk-mpr121-module01
      remote: ocapac
      revision: main
      path: modules/zmk-mpr121-module01
  self:
    path: config
```
